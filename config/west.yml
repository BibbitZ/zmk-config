## config/west.yml
```yaml
manifest:
  remotes:
    - name: bibbitz
      url-base: https://github.com/bibbitz
  projects:
    - name: zmk
      remote: bibbitz
      revision: main
      import: app/west.yml
  self:
    path: config
```
